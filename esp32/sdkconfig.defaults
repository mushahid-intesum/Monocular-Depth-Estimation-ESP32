## esp32/sdkconfig.defaults
```kconfig
# Camera Board — ESP32-S3 defaults
CONFIG_IDF_TARGET="esp32s3"

# Flash — board has 16MB
CONFIG_ESPTOOLPY_FLASHSIZE_16MB=y

# PSRAM (required for camera DMA buffers)
CONFIG_ESP32S3_SPIRAM_SUPPORT=y
CONFIG_SPIRAM=y
CONFIG_SPIRAM_MODE_OCT=y
CONFIG_SPIRAM_SPEED_40M=y

# Camera
CONFIG_CAMERA_TASK_STACK_SIZE=4096

# Partition table
CONFIG_PARTITION_TABLE_CUSTOM=n

# Main task stack
CONFIG_ESP_MAIN_TASK_STACK_SIZE=40960

# Task watchdog
CONFIG_ESP_TASK_WDT_TIMEOUT_S=30

# FreeRTOS
CONFIG_FREERTOS_HZ=1000

CONFIG_PARTITION_TABLE_CUSTOM=y
CONFIG_PARTITION_TABLE_CUSTOM_FILENAME="partitions.csv"
```
